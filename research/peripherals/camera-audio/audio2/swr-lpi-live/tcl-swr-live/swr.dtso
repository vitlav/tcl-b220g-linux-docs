/dts-v1/;
/plugin/;
/ { fragment@0 { target-path = "/soc@0"; __overlay__ { #address-cells=<2>; #size-cells=<2>;
		soundwire@62610000 {
			reg = <0 0x62610000 0 0x2000>;
			compatible = "qcom,soundwire-v1.5.1";
			status = "okay";
			interrupts = <0 297 1>;
			clocks = <0xdd>;
			clock-names = "iface";
			label = "RX";
			qcom,din-ports = <0>;
			qcom,dout-ports = <5>;

			qcom,ports-sinterval-low =	/bits/ 8 <0x03 0x1f 0x1f 0x07 0x00>;
			qcom,ports-offset1 =		/bits/ 8 <0x00 0x00 0x0b 0x01 0x00>;
			qcom,ports-offset2 =		/bits/ 8 <0x00 0x00 0x0b 0x00 0x00>;
			qcom,ports-hstart =		/bits/ 8 <0xff 0x03 0xff 0xff 0xff>;
			qcom,ports-hstop =		/bits/ 8 <0xff 0x06 0xff 0xff 0xff>;
			qcom,ports-word-length =	/bits/ 8 <0x01 0x07 0x04 0xff 0xff>;
			qcom,ports-block-pack-mode =	/bits/ 8 <0xff 0x00 0x01 0xff 0xff>;
			qcom,ports-lane-control =	/bits/ 8 <0x01 0x00 0x00 0x00 0x00>;
			qcom,ports-block-group-count =	/bits/ 8 <0xff 0xff 0xff 0xff 0x00>;

			#sound-dai-cells = <1>;
			#address-cells = <2>;
			#size-cells = <0>;
		};

}; }; };
